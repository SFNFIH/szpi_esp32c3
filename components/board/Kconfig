## components/board/Kconfig
```kconfig
menu "Board Configuration"

    config BOARD_LCKFB_SZPI_ESP32C3
        bool "LCKFB SZPI ESP32-C3 (立创·实战派)"
        default y
        help
            Pin definitions for the LCKFB SZPI ESP32-C3 development board.
            Reference: https://wiki.lckfb.com/zh-hans/szpi-esp32c3/

endmenu
```

## components/szpi_drivers/Kconfig.projbuild
```kconfig
menu "SZPI Drivers"

    config SZPI_MATTER_MINIMAL
        bool "Minimal drivers (I2C + GXHTC3 only, for Matter build)"
        default n
        help
            When enabled, only szpi_i2c and szpi_env are compiled.
            Disable LCD, touch, IMU, audio and LVGL to save flash/RAM.

endmenu
```
